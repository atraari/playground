## src/Kconfig
```kconfig
#
# Copyright 2014, NICTA
#
# This software may be distributed and modified according to the terms of
# the BSD 2-Clause license. Note that NO WARRANTY is provided.
# See "LICENSE_BSD2.txt" for details.
#
# @TAG(NICTA_BSD)
#

# Taken from RefOS project

# This file defines the Kconfig menu structure.

mainmenu "Project Configuration"

config COMMON_PATH
    string
    option env="COMMON_PATH"

menu "seL4 Kernel"
source "kernel/Kconfig"
endmenu

source libs/Kconfig
source apps/Kconfig

menu "Tools"
    source "tools/elfloader/Kconfig"
endmenu

source "$COMMON_PATH/Kconfig"
```

## src/apps/Kconfig
```kconfig
#
# Copyright 2014, NICTA
#
# This software may be distributed and modified according to the terms of
# the BSD 2-Clause license. Note that NO WARRANTY is provided.
# See "LICENSE_BSD2.txt" for details.
#
# @TAG(NICTA_BSD)
#

config SEL4_APPS_PATH
    string
    option env="SEL4_APPS_PATH"

menu "seL4 playgroundOS Applications"

source "$SEL4_APPS_PATH/init/Kconfig"

endmenu

menu "seL4 playgroundOS Build Options"

    config PLAYGROUND_DEBUG
        bool "Enable playgroundOS debugging output."
        default n
        help
            Enable debug printing in playgroundOS.

    config PLAYGROUND_DEBUG_VERBOSE
        bool "Enable playgroundOS extra verbose debugging output. "
        default n
        help
            Enable extra verbose debug printing in playgroundOS.
            Useful for debugging low level.
            Beware of really long logs.
            
    config PLAYGROUND_ANSI_COLOUR_OUTPUT
        bool "Enable ANSI escape sequenced colour output"
        depends on LIB_PLAYGROUND
        default y
        help
            Enable colour output using ANSI escape sequences. Disable if not outputting through serial
            to an ANSI-enabled terminal.

endmenu
```

## src/apps/init/Kconfig
```kconfig
#
# Copyright 2014, NICTA
#
# This software may be distributed and modified according to the terms of
# the BSD 2-Clause license. Note that NO WARRANTY is provided.
# See "LICENSE_BSD2.txt" for details.
#
# @TAG(NICTA_BSD)
#

config APP_INIT
    bool "playgroundOS Init"
    default y
    depends on LIB_SEL4 && LIB_MUSL_C && LIB_PLAYGROUND_SYS && LIB_PLAYGROUND && LIB_SEL4_PLAT_SUPPORT && LIB_CPIO && LIB_SEL4_ALLOCMAN && LIB_ELF && LIB_SEL4_VSPACE
    select HAVE_SEL4_APPS
    select APP_BOOTSTRAP
    help
        Simple init startup process.
```

## src/libs/Kconfig
```kconfig
#
# Copyright 2014, NICTA
#
# This software may be distributed and modified according to the terms of
# the BSD 2-Clause license. Note that NO WARRANTY is provided.
# See "LICENSE_BSD2.txt" for details.
#
# @TAG(NICTA_BSD)
#

config SEL4_LIBS_PATH
    string
    option env="SEL4_LIBS_PATH"

menu "seL4 Libraries"

# seL4 API library
source "$SEL4_LIBS_PATH/libsel4/Kconfig"

# core C and syscalls libraries
source "$SEL4_LIBS_PATH/libmuslc/Kconfig"
source "$SEL4_LIBS_PATH/libsel4muslcsys/Kconfig"
source "$SEL4_LIBS_PATH/libplaygroundsys/Kconfig"
source "$SEL4_LIBS_PATH/libplayground/Kconfig"

# simple resource abstraction
source "$SEL4_LIBS_PATH/libsel4simple/Kconfig"
source "$SEL4_LIBS_PATH/libsel4simple-default/Kconfig"
#source "$SEL4_LIBS_PATH/libsel4simple-stable/Kconfig"

# resource management
source "$SEL4_LIBS_PATH/libsel4allocman/Kconfig"
source "$SEL4_LIBS_PATH/libsel4vspace/Kconfig"
source "$SEL4_LIBS_PATH/libsel4vka/Kconfig"
source "$SEL4_LIBS_PATH/libsel4utils/Kconfig"
source "$SEL4_LIBS_PATH/libutils/Kconfig"

# elf anf filesystem libraries
source "$SEL4_LIBS_PATH/libelf/Kconfig"
source "$SEL4_LIBS_PATH/libcpio/Kconfig"

# driver related libraries
source "$SEL4_LIBS_PATH/libsel4platsupport/Kconfig"
source "$SEL4_LIBS_PATH/libplatsupport/Kconfig"
source "$SEL4_LIBS_PATH/libethdrivers/Kconfig"
source "$SEL4_LIBS_PATH/libpci/Kconfig"

# virtual machine management libraries
source "$SEL4_LIBS_PATH/libsel4vmm/Kconfig"

# debuging, benchmarking and testing libraries
source "$SEL4_LIBS_PATH/libsel4debug/Kconfig"
source "$SEL4_LIBS_PATH/libsel4bench/Kconfig"
source "$SEL4_LIBS_PATH/libsel4test/Kconfig"

endmenu
```

## src/libs/libplayground/Kconfig
```kconfig
#
# Copyright 2014, NICTA
#
# This software may be distributed and modified according to the terms of
# the BSD 2-Clause license. Note that NO WARRANTY is provided.
# See "LICENSE_BSD2.txt" for details.
#
# @TAG(NICTA_BSD)
#

config LIB_PLAYGROUND
    bool "Build playgroundOS API library"
    depends on LIB_SEL4
    default y
    help
        playgroundOS API library.
```
